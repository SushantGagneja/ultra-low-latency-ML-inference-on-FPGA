## esp32_firmware/main/Kconfig.projbuild
```kconfig
menu "BNN Trading Firmware"

config BNN_WIFI_SSID
    string "WiFi SSID"
    default "YOUR_WIFI_SSID"

config BNN_WIFI_PASSWORD
    string "WiFi password"
    default "YOUR_WIFI_PASSWORD"

config BNN_WIFI_MAX_RETRY
    int "WiFi connection retry count"
    default 8
    range 1 64

config BNN_BINANCE_URI
    string "Binance WebSocket URI"
    default "wss://stream.binance.com:9443/ws/btcusdt@bookTicker"

endmenu
```

## esp32_firmware/sdkconfig.defaults
```kconfig
CONFIG_ESPTOOLPY_FLASHSIZE_8MB=y
CONFIG_SPIRAM=y
CONFIG_SPIRAM_USE_MALLOC=y
CONFIG_FREERTOS_HZ=1000
```
