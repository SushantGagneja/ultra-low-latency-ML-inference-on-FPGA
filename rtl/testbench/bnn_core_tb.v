`timescale 1ns/1ps

module bnn_core_tb;

    // Clock and Reset
    reg sys_clk;
    reg rst_n;
    
    // SPI Pins
    reg  spi_sclk;
    reg  spi_cs_n;
    reg  spi_mosi;
    wire spi_miso;
    
    // Output
    wire fpga_done;
    
    // DUT
    bnn_top dut (
        .sys_clk(sys_clk),
        .rst_n(rst_n),
        .spi_sclk(spi_sclk),
        .spi_cs_n(spi_cs_n),
        .spi_mosi(spi_mosi),
        .spi_miso(spi_miso),
        .fpga_done(fpga_done)
    );

    // ============================================
    // Waveform Dump
    // ============================================
    initial begin
        $dumpfile("waveform.vcd");
        $dumpvars(0, bnn_core_tb);
    end

    // Clock generation (100 MHz)
    initial begin
        sys_clk = 0;
        forever #5 sys_clk = ~sys_clk;
    end

    // Test vectors (generated by Python script)
    `include "test_vectors.v"
    
    integer pass_count;
    integer fail_count;
    integer i;
    integer latency_cycles;
    integer max_latency_cycles;
    localparam integer MAX_DONE_CYCLES = 64;
    
    // SPI Master Task
    task spi_send_spike(input [15:0] spike);
        integer j;
        reg [23:0] packet;
        begin
            packet = {8'd0, spike}; // control = 0 (Inference), data = spike
            spi_cs_n = 0;
            #20;
            for (j = 23; j >= 0; j = j - 1) begin
                spi_mosi = packet[j];
                #12.5;
                spi_sclk = 1;
                #12.5;
                spi_sclk = 0;
            end
            #20;
            spi_cs_n = 1;
        end
    endtask
    
    task spi_read_decision(output [1:0] decision);
        integer j;
        reg [7:0] rx_byte;
        begin
            spi_cs_n = 0;
            rx_byte = 0;
            #20;
            for (j = 7; j >= 0; j = j - 1) begin
                spi_mosi = 0;
                #12.5;
                spi_sclk = 1;
                rx_byte[j] = spi_miso;
                #12.5;
                spi_sclk = 0;
            end
            #20;
            spi_cs_n = 1;
            decision = rx_byte[1:0];
        end
    endtask

    reg [1:0] got_decision;

    initial begin
        
        // Init
        rst_n = 0;
        spi_sclk = 0;
        spi_cs_n = 1;
        spi_mosi = 0;
        pass_count = 0;
        fail_count = 0;
        max_latency_cycles = 0;
        
        #100;
        rst_n = 1;
        #100;
        
        $display("========================================");
        $display("Starting VeriTrade BNN Core Simulation");
        $display("========================================");
        
        $display("--- Beginning Standard Vector Verification ---");
        
        for (i = 0; i < NUM_VECTORS; i = i + 1) begin

            // 1. Send Spike
            spi_send_spike(test_inputs[i]);
            
            // 2. Wait for Done
            latency_cycles = 0;

            while (fpga_done != 1'b1 && latency_cycles < MAX_DONE_CYCLES) begin
                @(posedge sys_clk);
                latency_cycles = latency_cycles + 1;
            end

            if (latency_cycles > max_latency_cycles) begin
                max_latency_cycles = latency_cycles;
            end

            if (fpga_done != 1'b1) begin
                $fatal(1, "Timeout waiting for fpga_done on vector %0d", i);
            end
            
            #50;
            
            // 3. Read Decision
            spi_read_decision(got_decision);
            
            if (got_decision === test_outputs[i]) begin
                pass_count = pass_count + 1;
            end else begin
                $display("FAIL [%4d] Input: %04X | Expected: %d | Got: %d | Core: %d | scores=%0d,%0d,%0d", 
                          i, test_inputs[i], test_outputs[i], got_decision,
                          dut.u_bnn_core.decision,
                          dut.u_bnn_core.score0,
                          dut.u_bnn_core.score1,
                          dut.u_bnn_core.score2);

                fail_count = fail_count + 1;
            end
            
            #100;
        end
        
        $display("========================================");
        $display("Simulation Complete");
        $display("PASS: %4d / %4d (%.2f %%)",
                 pass_count,
                 NUM_VECTORS,
                 (pass_count*100.0)/NUM_VECTORS);

        $display("FAIL: %4d / %4d", fail_count, NUM_VECTORS);
        $display("MAX DONE LATENCY: %0d sys_clk cycles", max_latency_cycles);
        $display("========================================");
        
        if (fail_count > 0)
            $fatal(1, "Hardware simulation mismatch found.");

        // =============================================================
        // Edge Case: SPI overflow stress test
        // Sends >24 SCLK edges to verify bit_count saturates correctly
        // and shift_rx is not corrupted by extra clock cycles.
        // =============================================================
        $display("--- Edge Case: SPI Overflow Stress Test ---");
        begin : spi_overflow_test
            integer j;
            reg [23:0] packet;
            reg [1:0] overflow_decision;

            // Send the first test vector using 32 clocks instead of 24
            packet = {8'd0, test_inputs[0]};
            spi_cs_n = 0;
            #20;
            // Send 24 valid bits
            for (j = 23; j >= 0; j = j - 1) begin
                spi_mosi = packet[j];
                #12.5;
                spi_sclk = 1;
                #12.5;
                spi_sclk = 0;
            end
            // Send 8 extra garbage bits (should be ignored after fix)
            for (j = 0; j < 8; j = j + 1) begin
                spi_mosi = 1'b1;  // Garbage 1s
                #12.5;
                spi_sclk = 1;
                #12.5;
                spi_sclk = 0;
            end
            #20;
            spi_cs_n = 1;

            // Wait for done
            latency_cycles = 0;
            while (fpga_done != 1'b1 && latency_cycles < MAX_DONE_CYCLES) begin
                @(posedge sys_clk);
                latency_cycles = latency_cycles + 1;
            end

            if (fpga_done != 1'b1) begin
                $fatal(1, "Timeout on SPI overflow edge case");
            end

            #50;
            spi_read_decision(overflow_decision);

            if (overflow_decision === test_outputs[0]) begin
                $display("PASS: SPI overflow test - extra clocks ignored correctly");
            end else begin
                $display("FAIL: SPI overflow test - Expected: %d Got: %d",
                         test_outputs[0], overflow_decision);
                $fatal(1, "SPI overflow corrupted inference result");
            end
        end
        $display("========================================");

        $finish;
    end

endmodule
